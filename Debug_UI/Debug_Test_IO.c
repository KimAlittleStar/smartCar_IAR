/****************************************************************************
* 文件名称 : IO 口 测试 用于测试 函数运行时间
* 文件功能 : IO 测试 功能
* 注意事项 :
*****************************************************************************/

#include "Debug_.h"


/****************************************************************************
* 函数名称: 调试IO口的初始化
* 函数功能 : 将调试IO口初始化。使示波器能检测到他高电平的时间
* 输入 :
* 输出 :
* 作者 :
*****************************************************************************/
void Debug_IOTest_Init(void)
{
	gpio_init(PTC4,GPO,LOW);			/* 初始化 PA17 低电平 输出 */
// #if Debug_IO_Function == 1
// #warning "函数未重写"		/*!< 重写后请删除此段 */
// #endif
}


/****************************************************************************
* 函数名称: IO调试 计时开始
* 函数功能 : 将 调试 IO 口电平拉高。
* 输入 :
* 输出 :
* 作者 :
*****************************************************************************/
void Debug_IOTest_Star(void)
{

	PTC4_OUT = HIGH;					/* 开始计时将电平拉高 */
// #if Debug_IO_Function == 1
// 	#warning "函数未重写"		/*!< 重写后请删除此段 */
// #endif
}


/****************************************************************************
* 函数名称: IO 调试 计时结束
* 函数功能 : 将 调试IO口电平拉低
* 输入 :
* 输出 :
* 作者 :
*****************************************************************************/
void Debug_IOTest_Over(void)
{
	PTC4_OUT = LOW;				/* 计时结束 拉低电平 */
// #if Debug_IO_Function == 1
// 	#warning "函数未重写"		/*!< 重写后请删除此段 */
// #endif
}

/**********************************************************************************
* 函数名称: Debug_getNumFormStr
* 函数功能: 将输入字符串中的数字提取出来 分类存储 若数字为0  或无数字则不改变
* 函数输入: void input:数字 数组 str 暗号数组 key，这个数原来的数值 oldvalue
* 函数输出: void output: 提取出来的数字大小 
* 作者 :author:@Kim_alittle_star
**********************************************************************************/
u32_Pro Debug_getNumFormStr(const String_Pro str,const String_Pro key,u32_Pro oldValue )
{

	String_Pro pp;
	u32_Pro const_p = 0;
	pp = strstr(str,key);
	if(pp != NULL)
	{
		const_p = 0;
//		pp = (String_Pro)str;
		while( *(pp)!= '\0' && (*(pp) < '0' || *(pp) > '9') )
		{
			
					pp++;
		}
		while(*pp!= '\0' && *pp >='0'&& *pp<='9')
		{
			const_p = const_p*10 + (*pp-'0');
			pp++;
		}
	}
	
	if(const_p == 0)
	{
		const_p = oldValue;
	}
	return const_p;
}

